## drivers/misc/kconsole/Kconfig
```kconfig
config KCONSOLE
    tristate "KConsole Kernel Module"
    default y
    help
      Дозволяє виконувати команди з ядра.
```

## drivers/net/wireless/rtl8188eus/Kconfig
```kconfig
config RTL8188EU
	tristate "Realtek 8188E USB WiFi"
	default y
	---help---
	  Help message of RTL8188EU
```
